// Dumps REAL layout output from the ESP-OS kernel as JSON, so the visual
// preview is generated by the same code that will run on the board.
#include <stdio.h>
#include <string.h>
#include <stdlib.h>
#include "eos_wm.h"
#include "eos_bar.h"
#include "eos_theme.h"

// The theme names the face; the face fixes the advance the bar measures with.
static int font_cw(const char *f) {
    if (!strcmp(f,"tiny")) return 4;
    if (!strcmp(f,"med"))  return 8;
    if (!strcmp(f,"big"))  return 12;
    return 6;                      // "small", and the fallback for anything junk
}

static const char *APP[] = {"term","buddy","files","settings","arcade","cpm"};

static int slurp(const char *p, char *buf, int max) {
    FILE *f = fopen(p, "rb"); if (!f) return -1;
    int n = (int)fread(buf, 1, max - 1, f); fclose(f); buf[n] = 0; return n;
}
static void jstr(const char *s) {
    putchar('"');
    for (; s && *s; s++) { if (*s=='"'||*s=='\\') putchar('\\'); putchar(*s); }
    putchar('"');
}
static void hex(eos_rgb_t c) { printf("\"#%02x%02x%02x\"", c.r, c.g, c.b); }

static void scenario(const char *label, const char *themefile,
                     int W, int H, const int *apps, int napps,
                     int focus_idx, const char *panel)
{
    char buf[16384];
    eos_theme_t th;
    if (slurp(themefile, buf, sizeof buf) > 0) {
        if (eos_theme_parse(&th, buf, (int)strlen(buf)) != 0) eos_theme_default(&th);
    } else eos_theme_default(&th);

    eos_wm_cfg_t cfg = { 96, 60, th.m.gap, th.m.bar_h, th.m.tab_h };
    if (W < 200) { cfg.min_tile_w = 60; cfg.min_tile_h = 24; }
    if (H > 400) { cfg.min_tile_h = 90; }

    eos_rect_t scr = { 0, 0, (int16_t)W, (int16_t)H };
    eos_wm_t wm; eos_wm_init(&wm, &cfg);
    for (int i = 0; i < napps; i++) eos_wm_open(&wm, (uint16_t)apps[i], scr);
    if (focus_idx >= 0) eos_wm_focus_win(&wm, focus_idx);

    eos_tile_t t[EOS_MAX_WINDOWS*2];
    int n = eos_wm_layout(&wm, scr, t, EOS_MAX_WINDOWS*2);

    eos_bar_status_t st; eos_bar_status_init(&st);
    st.ws_occupied = 0x0007; st.ws_active = 0;
    st.title = APP[apps[focus_idx < 0 ? 0 : focus_idx]];
    st.wifi = EOS_WIFI_UP; st.wifi_rssi = -58;
    st.brain_up = true; st.brain_model = "qwen3.5:2b";
    st.free_heap = 21504; st.mood = EOS_MOOD_HAPPY;
    st.hour = 14; st.minute = 32; st.clock_valid = true;
    // A 64px-tall panel cannot afford an 8x13 face, so it clamps to tiny the
    // way the display backend will have to.
    int char_w = font_cw(th.m.font);
    if (H <= 64 && char_w > 4) char_w = 4;
    eos_bar_metrics_t bm; eos_bar_metrics_init(&bm, (int16_t)char_w, 4);
    eos_bar_seg_t seg[EOS_BAR_SEGS];
    int ns = eos_bar_build(&st, &bm, (int16_t)W, seg, EOS_BAR_SEGS);

    printf("{\"label\":"); jstr(label);
    printf(",\"panel\":"); jstr(panel);
    printf(",\"w\":%d,\"h\":%d,\"cw\":%d,\"theme\":", W, H, char_w); jstr(th.name);
    printf(",\"metrics\":{\"gap\":%d,\"border\":%d,\"bar_h\":%d,\"tab_h\":%d,\"radius\":%d}",
           th.m.gap, th.m.border, th.m.bar_h, th.m.tab_h, th.m.radius);
    printf(",\"tiles\":[");
    for (int i = 0; i < n; i++) {
        if (i) putchar(',');
        printf("{\"win\":%d,\"app\":", t[i].win); jstr(t[i].app_id < 6 ? APP[t[i].app_id] : "?");
        printf(",\"x\":%d,\"y\":%d,\"w\":%d,\"h\":%d,\"visible\":%s,\"focused\":%s",
               t[i].rect.x, t[i].rect.y, t[i].rect.w, t[i].rect.h,
               t[i].visible?"true":"false", t[i].focused?"true":"false");
        printf(",\"tab_group\":%d,\"tab_index\":%d,\"tab_count\":%d",
               t[i].tab_group, t[i].tab_index, t[i].tab_count);
        printf(",\"tab\":{\"x\":%d,\"y\":%d,\"w\":%d,\"h\":%d}}",
               t[i].tab_rect.x, t[i].tab_rect.y, t[i].tab_rect.w, t[i].tab_rect.h);
    }
    printf("],\"bar\":[");
    for (int i = 0; i < ns; i++) {
        if (i) putchar(',');
        printf("{\"t\":"); jstr(seg[i].text);
        printf(",\"role\":%d,\"x\":%d,\"w\":%d}", seg[i].role, seg[i].x, seg[i].w);
    }
    printf("]}");
}

static const char *THEMES[] = {"carbon","catppuccin-mocha","cyd-amber","ember",
                               "goldleaf","gruvbox","tokyonight"};
int main(void) {
    char p[256];
    printf("{");
    for (unsigned ti = 0; ti < sizeof THEMES/sizeof *THEMES; ti++) {
        if (ti) printf(",");
        printf("\"%s\":[", THEMES[ti]);
        snprintf(p, sizeof p, "kernel/theme/themes/%s.json", THEMES[ti]);
        int a1[] = {0,1,2,3};   scenario("CYD 2.4\" ILI9341",    p, 320,240, a1,4, 0, "ILI9341 320x240");      printf(",");
        int a2[] = {0,1,4,2,3}; scenario("wavvy 4\" ILI9488",    p, 320,480, a2,5, 0, "ILI9488 320x480 portrait"); printf(",");
        int a3[] = {0,1,2};     scenario("C5 1.47\" ST7789",     p, 320,172, a3,3, 0, "ST7789 320x172");       printf(",");
        int a4[] = {0,1,2};     scenario("OLED 0.96\" SSD1306",  p, 128,64,  a4,3, 0, "SSD1306 128x64 mono");
        printf("]");
    }
    printf("}\n");
    return 0;
}
